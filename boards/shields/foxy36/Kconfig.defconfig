## boards/shields/foxy36/Kconfig.defconfig
```kconfig
if SHIELD_FOXY36

# Name must be less than 16 characters long!
config ZMK_KEYBOARD_NAME
    default "Foxy36"

endif
```

## boards/shields/foxy36/Kconfig.shield
```kconfig
# No whitespace after the comma or in your keyboard name!
config SHIELD_FOXY36
    def_bool $(shields_list_contains,foxy36)
```
